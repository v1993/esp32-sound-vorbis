## Kconfig
```kconfig
menu "Ogg vorbis sound provider"

config VORBIS_INTROSPECTION
	bool "Make OggVorbis_File and mutex public"
	default n
	help
		You may want to call raw operations on OggVorbis_File.
		In this case enable it and don't forget to lock `safeState` mutex.

config VORBIS_BUFFER_SIZE
	int "Buffer size for channel"
	default 2048
	range 512 8192
	help
		Size of buffer per channel in bytes (1 sample = 2 bytes).
		Alloacated memory size = this*channels_count
		In most cases default value will work.

config VORBIS_STACK_SIZE
	int "Stack size for ogg vorbis task"
	default 8192
	range 4096 32768
	help
		Reduce at you own risk, increase in case of stack overflow in "SProvTask".

endmenu
```
